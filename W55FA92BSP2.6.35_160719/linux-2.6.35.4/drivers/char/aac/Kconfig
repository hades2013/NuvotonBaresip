## W55FA92BSP2.6.35_160719/linux-2.6.35.4/drivers/char/aac/Kconfig
```kconfig
config  W55FA92_AAC
	bool "Nuvoton W55FA92 AAC Device Driver"
	depends on ARCH_W55FA92
	help
		Enable AAC or not.
```

## W55FA92BSP2.6.35_160719/linux-2.6.35.4/drivers/char/blt/Kconfig
```kconfig
config  W55FA92_BLT
	tristate "Nuvoton W55FA92 BLT Device Driver"
	depends on ARCH_W55FA92
	help
		Enable BLT or not.
```

## W55FA92BSP2.6.35_160719/linux-2.6.35.4/drivers/crypto/w55fa92-aes/Kconfig
```kconfig
config CRYPTO_DEV_W55FA92_AES
	tristate "W55FA92 AES H/W accelerator"
	depends on ARCH_W55FA92
	select CRYPTO_ALGAPI
	select CRYPTO_BLKCIPHER
	help
		Enable Nuvoton W55FA92 AES H/W accelerator
```

## W55FA92BSP2.6.35_160719/linux-2.6.35.4/drivers/input/misc/w55fa92_adc/Kconfig
```kconfig
config INPUT_W55FA92_ADC
	bool "W55FA92 Input ADC Function"
	depends on CPU_W55FA92
	help
	  If unsure, say N (but it's safe to say "Y").

menu "ADC Function Select"
	depends on INPUT_W55FA92_ADC

config TOUCH_DETECTION
        bool "Touch panel detection"
config BATTERY_DETECTION
        bool "Battery detection"
config KEYPAD_DETECTION
        bool "Keypad detection"
endmenu

choice
    prompt "BATTERY detection channel selection"
		default BATTERY_CHANNEL_1
	depends on BATTERY_DETECTION
  
		config BATTERY_CHANNEL_1
			bool "Battery detection from channel 1"
		config BATTERY_CHANNEL_2
			bool "Battery detection from channel 2"
		config BATTERY_CHANNEL_3
			bool "Battery detection from channel 3"
endchoice

choice
    prompt "Keypad detection channel selection"
		default KEYPAD_CHANNEL_2
	depends on KEYPAD_DETECTION
  
		config KEYPAD_CHANNEL_1
			bool "Keypad detection from channel 1"
		config KEYPAD_CHANNEL_2
			bool "Keypad detection from channel 2"
		config KEYPAD_CHANNEL_3
			bool "Keypad detection from channel 3"
endchoice
```

## W55FA92BSP2.6.35_160719/linux-2.6.35.4/drivers/media/video/w55fa92_dev1/Kconfig
```kconfig
config W55FA92_VIDEOIN_DEV1
	bool "W55FA92 video capture port 1 support"
	depends on ARCH_W55FA92 && VIDEO_DEV
	---help---
	  Say Y here if you have W55FA92chip(nuvoTon).

	  To compile this driver as a module, choose M here: the
	  module will be called W55FA92_videoin_dev1.

config VIN_DEV1_ENCODE_WIDTH
        int "VideoIn DEV1 encode width"
        default 640
        depends on W55FA92_VIDEOIN_DEV1
        help
          Default is 640

config VIN_DEV1_ENCODE_HEIGHT
        int "VideoIn DEV1 encode height"
        default 480
        depends on W55FA92_VIDEOIN_DEV1
        help
          Default is 480

config VIN_DEV1_ENCODE_BUF_NO
        int "VideoIn DEV1 encode buffer numbers"
		range 2 3
        default 3
        depends on W55FA92_VIDEOIN_DEV1
        help
          Specified the encode buffer numbers

config VIN_DEV1_PREVIEW_WIDTH
        int "VideoIn DEV1 preview width"
        default 320
        depends on W55FA92_VIDEOIN_DEV1
        help
          Default is 320

config VIN_DEV1_PREVIEW_HEIGHT
        int "VideoIn DEV1 preview height"
        default 240
        depends on W55FA92_VIDEOIN_DEV1
        help
          Default is 240

config VIN_DEV1_PREVIEW_BUF_NO
        int "VideoIn DEV1 preview buffer numbers"
		range 3 3
        default 3
        depends on W55FA92_VIDEOIN_DEV1
        help
          Specified the preview buffer numbers

choice 
	prompt "Board Select"
        default DEV_BOARD_DEV1
	depends on W55FA92_VIDEOIN_DEV1
		config  DEV_BOARD_DEV1
			bool "Developement board"
		config  DEMO_BOARD_DEV1
			bool "Demo board"
		config  VIDEODOOR_BOARD_DEV1
			bool "Videodoor board"
endchoice

config SUPPORT_SENSOR_RESET_DEV1
	bool "Support sensor reset pin"
	default y
	depends on W55FA92_VIDEOIN_DEV1
	---help---
	  Say Y here if you need sensor reset pin. Please refer the circit. 

config SUPPORT_SENSOR_POWER_DOWN_DEV1
	bool "Support sensor power down pin"
	default y
	depends on W55FA92_VIDEOIN_DEV1
	---help---
	  Say Y here if you need sensor power down pin. Please refer the circit. 

config SUPPORT_SHARE_PACKET_BUFFER_DEV1
	tristate "Support share packet buffer with senor port 2"
	depends on W55FA92_VIDEOIN_DEV1
	---help---
	  Say Y here if you wnat to support share packet buffer with sensor port 2

config SUPPORT_SHARE_PLANAR_BUFFER_DEV1
	tristate "Support share planar buffer with senor port 2"
	depends on W55FA92_VIDEOIN_DEV1
	---help---
	  Say Y here if you wnat to support share planar buffer with sensor port 2

config SHARE_SENSOR
	tristate "Support share sensor to capture port 2"
	depends on W55FA92_VIDEOIN_DEV1
	---help---
	  Say Y here if you wnat to support share sensor to capture port 2.

config MOTION_DETECTION_DEV1
	tristate "Support motion detection function"
	depends on W55FA92_VIDEOIN_DEV1
	---help---
	  Say Y here if you wnat to support motion detection function.

choice 
	prompt "Encode format"
        default PLANAR_YUV422_YUV420_DEV1
	depends on W55FA92_VIDEOIN_DEV1
	
		config  PLANAR_YUV422_YUV420_DEV1
			bool "Support planar yuv422/yuv420"
		config  PLANAR_YUV420_DEV1
			bool "Support planar yuv420"
endchoice

choice
    prompt "Video Sensor support"
		default SENSOR_OV7725_DEV1
	depends on W55FA92_VIDEOIN_DEV1
 
		config SENSOR_OV9660_DEV1
			bool "OV9660 sensor support"
		config SENSOR_OV7670_DEV1
			bool "OV7670 sensor support"
		config SENSOR_OV7725_DEV1
			bool "OV7725 sensor support"
		config SENSOR_NT99140_DEV1
			bool "NT99140 sensor support"
		config SENSOR_NT99141_DEV1
			bool "NT99141 sensor support"
		config SENSOR_NT99142_DEV1
			bool "NT99142 sensor support"
		config SENSOR_NT99050_DEV1
			bool "NT99050 sensor support"
		config SENSOR_NT99160_DEV1
			bool "NT99160 sensor support"
		config SENSOR_NT99340_DEV1
			bool "NT99340 sensor support"
		config SENSOR_NT99252_DEV1
			bool "NT99252 sensor support"
		config SENSOR_NT99240_DEV1
			bool "NT99240 sensor support"
		config SENSOR_HM1375_DEV1
			bool "HM1375 sensor support"	
		config SENSOR_HM1055_DEV1
			bool "HM1055 sensor support"	
		config SENSOR_SP1628_DEV1
			bool "SP1628 sensor support"
		config SENSOR_TW9912_DEV1
			bool "TW9912 sensor support"	
endchoice
choice
    prompt "AEC/AWB target frame rate selection"
		default TARGET_25FPS
	depends on SENSOR_NT99141_DEV1 || SENSOR_NT99142_DEV1
		config TARGET_25FPS
			bool "AEC/AWB target fixed 25fps"
		config TARGET_23FPS
			bool "AEC/AWB target fixed 23fps"
		config TARGET_15FPS
			bool "AEC/AWB target 15fps at least"
		config TARGET_10FPS
			bool "AEC/AWB target 10fps at least"
endchoice

choice
    prompt "Frame rate selection"
		default 30_FRAME_DEV1
	depends on SENSOR_NT99050_DEV1  
		config 30_FRAME_DEV1
			bool "30 frames/sec"
		config 60_FRAME_DEV1
			bool "60 frames/sec"
endchoice

choice
    prompt "NTSC/PAL System selection"
		default PAL_SYSTEM_DEV1
	depends on SENSOR_TW9912_DEV1  
		config PAL_SYSTEM_DEV1
			bool "PAL system"
		config NTSC_SYSTEM_DEV1
			bool "NTSC system"
endchoice

choice
    prompt "Video port connection"
		default VIDEO_PORT1
	depends on W55FA92_VIDEOIN_DEV1
  
		config VIDEO_PORT1
			bool "Data/Control==>GPB port"
		config VIDEO_PORT2
			bool "Data==>GPC port. Control==>GPA/GPE port"
		config VIDEO_PORT2_1
			bool "Data==>GPG/GPD port. Control==>GPD port"
endchoice


choice
    prompt "Flicker Setting"
		default FLICKER_60HZ
	depends on W55FA92_VIDEOIN_DEV1
  
		config FLICKER_60HZ_DEV1
			bool "Flicker setting is 60Hz"
		config FLICKER_50HZ_DEV1
			bool "Flicker setting is 50Hz"		
endchoice
```

## W55FA92BSP2.6.35_160719/linux-2.6.35.4/drivers/media/video/w55fa92_dev2/Kconfig
```kconfig
config W55FA92_VIDEOIN_DEV2
	bool "W55FA92 video capture port 2 support"
	depends on ARCH_W55FA92 && VIDEO_DEV
	---help---
	  Say Y here if you have W55FA92chip(nuvoTon).

	  To compile this driver as a module, choose M here: the
	  module will be called W55FA92_videoin_dev2.

config VIN_DEV2_ENCODE_WIDTH
        int "VideoIn DEV2 encode width"
        default 640
        depends on W55FA92_VIDEOIN_DEV2
        help
          Default is 640

config VIN_DEV2_ENCODE_HEIGHT
        int "VideoIn DEV2 encode height"
        default 480
        depends on W55FA92_VIDEOIN_DEV2
        help
          Default is 480

config VIN_DEV2_ENCODE_BUF_NO
        int "VideoIn DEV2 encode buffer numbers"
		range 2 3
        default 3
        depends on W55FA92_VIDEOIN_DEV2
        help
          Specified the encode buffer numbers

config VIN_DEV2_PREVIEW_WIDTH
        int "VideoIn DEV2 preview width"
        default 320
        depends on W55FA92_VIDEOIN_DEV2
        help
          Default is 320

config VIN_DEV2_PREVIEW_HEIGHT
        int "VideoIn DEV2 preview height"
        default 240
        depends on W55FA92_VIDEOIN_DEV2
        help
          Default is 240

config VIN_DEV2_PREVIEW_BUF_NO
        int "VideoIn DEV2 preview buffer numbers"
		range 3 3
        default 3
        depends on W55FA92_VIDEOIN_DEV2
        help
          Specified the preview buffer numbers

choice 
	prompt "Board Select for dev2"
        default DEV_BOARD_DEV2
	depends on W55FA92_VIDEOIN_DEV2 && !W55FA92_VIDEOIN_DEV1

		config  DEV_BOARD_DEV2
			bool "Developement board"
		config  DEMO_BOARD_DEV2
			bool "Demo board"
		config  VIDEODOOR_BOARD_DEV2
			bool "Videodoor board"
endchoice

config SUPPORT_SENSOR_RESET_DEV2
	bool "Support sensor reset pin"
	default y
	depends on W55FA92_VIDEOIN_DEV2
	---help---
	  Say Y here if you need sensor reset pin. Please refer the circit. 

config SUPPORT_SENSOR_POWER_DOWN_DEV2
	bool "Support sensor power down pin"
	default y
	depends on W55FA92_VIDEOIN_DEV2
	---help---
	  Say Y here if you need sensor power down pin. Please refer the circit

config MOTION_DETECTION_DEV2
	tristate "Support motion detection function"
	depends on W55FA92_VIDEOIN_DEV2
	---help---
	  Say Y here if you wnat to support motion detection function.

config NON_STANDARD_I2C_DEV2
	tristate "Support non-standard i2c"
	depends on W55FA92_VIDEOIN_DEV2 && !SHARE_SENSOR
	---help---
	  Say Y here if your sensors use same slave address.

choice 
	prompt "Encode format"
        default PLANAR_YUV422_YUV420_DEV2
	depends on W55FA92_VIDEOIN_DEV2
	
		config  PLANAR_YUV422_YUV420_DEV2
			bool "Support planar yuv422/yuv420"
		config  PLANAR_YUV420_DEV2
			bool "Support planar yuv420"
endchoice

choice
    prompt "Video Sensor support"
		default SENSOR_OV7725_DEV2
	depends on W55FA92_VIDEOIN_DEV2
 
		config SENSOR_OV9660_DEV2
			bool "OV9660 sensor support"
		config SENSOR_OV7670_DEV2
			bool "OV7670 sensor support"
		config SENSOR_OV7725_DEV2
			bool "OV7725 sensor support"
		config SENSOR_NT99140_DEV2
			bool "NT99140 sensor support"
		config SENSOR_NT99141_DEV2
			bool "NT99141 sensor support"
		config SENSOR_NT99050_DEV2
			bool "NT99050 sensor support"
		config SENSOR_NT99160_DEV2
			bool "NT99160 sensor support"
		config SENSOR_NT99340_DEV2
			bool "NT99340 sensor support"
		config SENSOR_NT99252_DEV2
			bool "NT99252 sensor support"
		config SENSOR_NT99240_DEV2
			bool "NT99240 sensor support"
		config SENSOR_HM1375_DEV2
			bool "HM1375 sensor support"	
		config SENSOR_HM1055_DEV2
			bool "HM1055 sensor support"
		config SENSOR_TW9912_DEV2
			bool "TW9912 sensor support"
endchoice

choice
    prompt "Frame rate selection"
		default 30_FRAME_DEV2
	depends on SENSOR_NT99050_DEV2
		config 30_FRAME_DEV2
			bool "30 frames/sec"
		config 60_FRAME_DEV2
			bool "60 frames/sec"
endchoice

choice
    prompt "NTSC/PAL System selection"
		default PAL_SYSTEM_DEV2
	depends on SENSOR_TW9912_DEV2
		config PAL_SYSTEM_DEV2
			bool "PAL system"
		config NTSC_SYSTEM_DEV2
			bool "NTSC system"
endchoice

choice
    prompt "Video port connection"
		default VIDEO_PORT2_0_DEV2
	depends on W55FA92_VIDEOIN_DEV2 && !SHARE_SENSOR

		config VIDEO_PORT2_0_DEV2
			bool "Data==>GPC port. Control==>GPA/GPE port"
		config VIDEO_PORT2_1_DEV2
			bool "Data==>GPG/GPD port. Control==>GPD port"
endchoice
choice
    prompt "Flicker Setting"
		default FLICKER_60HZ_DEV2
	depends on W55FA92_VIDEOIN_DEV2  && !SHARE_SENSOR
  
		config FLICKER_60HZ_DEV2
			bool "Flicker setting is 60Hz"
		config FLICKER_50HZ_DEV2
			bool "Flicker setting is 50Hz"		
endchoice
```

## W55FA92BSP2.6.35_160719/linux-2.6.35.4/drivers/net/arm/Kconfig
```kconfig
#
# Acorn Network device configuration
#  These are for Acorn's Expansion card network interfaces
#
config ARM_AM79C961A
	bool "ARM EBSA110 AM79C961A support"
	depends on ARM && ARCH_EBSA110
	select CRC32
	help
	  If you wish to compile a kernel for the EBSA-110, then you should
	  always answer Y to this.

config ARM_ETHER1
	tristate "Acorn Ether1 support"
	depends on ARM && ARCH_ACORN
	help
	  If you have an Acorn system with one of these (AKA25) network cards,
	  you should say Y to this option if you wish to use it with Linux.

config ARM_ETHER3
	tristate "Acorn/ANT Ether3 support"
	depends on ARM && ARCH_ACORN
	help
	  If you have an Acorn system with one of these network cards, you
	  should say Y to this option if you wish to use it with Linux.

config ARM_ETHERH
	tristate "I-cubed EtherH/ANT EtherM support"
	depends on ARM && ARCH_ACORN
	select CRC32
	help
	  If you have an Acorn system with one of these network cards, you
	  should say Y to this option if you wish to use it with Linux.

config ARM_AT91_ETHER
	tristate "AT91RM9200 Ethernet support"
	depends on ARM && ARCH_AT91RM9200
	select MII
	help
	  If you wish to compile a kernel for the AT91RM9200 and enable
	  ethernet support, then you should always answer Y to this.

config ARM_KS8695_ETHER
	tristate "KS8695 Ethernet support"
	depends on ARM && ARCH_KS8695
	select MII
	help
	  If you wish to compile a kernel for the KS8695 and want to
	  use the internal ethernet then you should answer Y to this.

config EP93XX_ETH
	tristate "EP93xx Ethernet support"
	depends on ARM && ARCH_EP93XX
	select MII
	help
	  This is a driver for the ethernet hardware included in EP93xx CPUs.
	  Say Y if you are building a kernel for EP93xx based devices.

config IXP4XX_ETH
	tristate "Intel IXP4xx Ethernet support"
	depends on ARM && ARCH_IXP4XX && IXP4XX_NPE && IXP4XX_QMGR
	select PHYLIB
	help
	  Say Y here if you want to use built-in Ethernet ports
	  on IXP4xx processor.

config W90P910_ETH
	tristate "Nuvoton w90p910 Ethernet support"
	depends on ARM && ARCH_W90X900
	select PHYLIB
	select MII
	help
	  Say Y here if you want to use built-in Ethernet ports
	  on w90p910 processor.

config W55FA92_ETH
	bool "Nuvoton w55fa92 Ethernet support"
	depends on ARM && ARCH_W55FA92
	select PHYLIB
	select MII
	help
	  Say Y here if you want to use built-in Ethernet ports
	  on w55fa92 processor.
choice
	prompt "Ethernet port select"
		default W55FA92_ETH_PORT0
		depends on W55FA92_ETH

config W55FA92_ETH_PORT0
	bool "W55FA92 Ethernet 1st Port"

config W55FA92_ETH_PORT1
	bool "W55FA92 Ethernet 2nd Port"
endchoice

choice
	prompt "Ethernet phy select"
		default W55FA92_ETH_PHY_RTL8201
		depends on W55FA92_ETH
		
config W55FA92_ETH_PHY_RTL8201
	bool "RTL8201 PHY"
	depends on W55FA92_ETH
	help
	  Say Y here if you want to use RTL8201 PHY
          on w55fa92 processor.

config W55FA92_ETH_PHY_SR8201G
	bool "SR8201G PHY"
	depends on W55FA92_ETH
	help
	  Say Y here if you want to use SR8201G PHY
          on w55fa92 processor.

config W55FA92_ETH_PHY_LAN8720AI
	bool "LAN8720AI PHY"
	depends on W55FA92_ETH
	help
	  Say Y here if you want to use LAN8720AI PHY
          on w55fa92 processor.

endchoice
        
config W55FA92_ETH_NAPI
	bool "NAPI Version"
	depends on W55FA92_ETH
	help
	  Say Y here if you want to use NAPI version
          on w55fa92 processor.
                    
config W55FA92_WAKE_ON_LAN
	bool "WOL Wake On Lan"
	depends on W55FA92_ETH
	help
	  Say Y here if you want support WOL
          on w55fa92 processor.
```
