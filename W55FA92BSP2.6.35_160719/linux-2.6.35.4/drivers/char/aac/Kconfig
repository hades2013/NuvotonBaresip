## W55FA92BSP2.6.35_160719/linux-2.6.35.4/sound/soc/w55fa92adc/Kconfig
```kconfig
##
## W55FA9X series ADC audio recording
##

#config SND_SOC_W55FA92
#	tristate "W55FA92 Audio Recording Device"
#	depends on ARCH_W55FA92
#	help
#	  This option enables support for ADC recording mode on the W55FA92 SoC.

config SND_SOC_W55FA92_ADC
	tristate "W55FA92 ADC recording for demo board"
#	depends on SND_SOC_W55FA92
	select SND_SOC_W55FA92_CODEC_ADC     
	help
	  Select this option to enable audio recording from ADC on the
	  W55FA92 demoboard.
```
